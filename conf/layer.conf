## conf/layer.conf
```bitbake
# We have a conf and classes directory, add to BBPATH
BBPATH .= ":${LAYERDIR}"

# We have a recipes directory, add to BBFILES
BBFILES += "${LAYERDIR}/recipes-*/*/*.bb \
	${LAYERDIR}/recipes-*/*/*.bbappend"

BBFILE_COLLECTIONS += "fcitx"
BBFILE_PATTERN_fcitx := "^${LAYERDIR}/"
BBFILE_PRIORITY_fcitx = "6"

LAYERSERIES_COMPAT_fcitx = "kirkstone"

LAYERDEPENDS_fcitx = "openembedded-layer"
```
